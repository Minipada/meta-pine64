## conf/layer.conf
```bitbake
# We have a conf and classes directory, add to BBPATH
BBPATH .= ":${LAYERDIR}"

# We have recipes-* directories, add to BBFILES
BBFILES += "${LAYERDIR}/recipes-*/*/*.bb \
	${LAYERDIR}/recipes-*/*/*.bbappend"

BBFILE_COLLECTIONS += "pine64"
BBFILE_PATTERN_pine64 = "^${LAYERDIR}/"
BBFILE_PRIORITY_pine64 = "9"
```

## conf/machine/include/pine64-base.inc
```bitbake
include conf/machine/include/pine64-default-settings.inc
include conf/machine/include/pine64-default-versions.inc
include conf/machine/include/pine64-default-providers.inc

SOC_FAMILY = "sun50i"

IMAGE_FSTYPES ?= "tar.bz2 ext3 pine64-sdimg"

#SERIAL_CONSOLE = "115200 ttyS0"

#TODO Add XSERVER
#XSERVER = " \
#    xserver-xorg \
#    xf86-input-evdev \
#    xf86-input-mouse \
#    xf86-input-keyboard \
#    xf86-video-fbdev \
#    "

#TODO Add Kernel device Tree
#KERNEL_DEVICETREE ?= " \
#  sun50i-a64-pine64.dtb \
#"

#KERNEL_IMAGETYPE="Image"

#TODO Check which one the board would need
#MACHINE_FEATURES += "usbhost keyboard screen alsa wifi sdio"

#MACHINE_EXTRA_RRECOMMENDS += " kernel-modules"

#TODO Check which files are needed
#IMAGE_BOOT_FILES ?= "my-folder/* ${KERNEL_IMAGETYPE};${SDIMG_KERNELIMAGE}"
```

## conf/machine/include/pine64-providers.inc
```bitbake
# Pine64 BSP default providers

PREFERRED_PROVIDER_virtual/kernel="linux-pine64"
PREFERRED_PROVIDER_u-boot ?= "u-boot-pine64"
PREFERRED_PROVIDER_virtual/xserver ?= "xserver-xorg"
PREFERRED_PROVIDER_virtual/egl ?= "userland"
PREFERRED_PROVIDER_virtual/libgles2 ?= "userland"
PREFERRED_PROVIDER_virtual/libgl ?= "mesa-gl"
PREFERRED_PROVIDER_virtual/mesa ?= "mesa-gl"
PREFERRED_PROVIDER_jpeg ?= "jpeg"

PREFERRED_VERSION_gcc                                           ?= "5.2" 
PREFERRED_VERSION_gcc-cross                                     ?= "5.2"  
PREFERRED_VERSION_gcc-cross-initial                             ?= "5.2" 
PREFERRED_VERISON_gcc-crosssdk-initial-x86_64                   ?= "5.2" 
PREFERRED_VERSION_gcc-cross-intermediate                        ?= "5.2" 
PREFERRED_VERSION_gcc-cross-canadian                            ?= "5.2" 
PREFERRED_VERSION_gcc-crosssdk                                  ?= "5.2" 
PREFERRED_VERSION_gcc-crosssdk-initial                          ?= "5.2" 
PREFERRED_VERSION_gcc-crosssdk-intermediate                     ?= "5.2" 
PREFERRED_VERSION_gcc-runtime                                   ?= "5.2" 
PREFERRED_VERSION_nativesdk-gcc-runtime                         ?= "5.2" 
PREFERRED_VERSION_libgcc                                        ?= "5.2" 
PREFERRED_VERSION_libgcc-initial                                ?= "5.2" 
PREFERRED_VERSION_gcc-cross-${TARGET_ARCH}                      ?= "5.2" 
PREFERRED_VERSION_gcc-crosssdk-${SDK_ARCH}                      ?= "5.2" 
PREFERRED_VERSION_gcc-cross-canadian-${TRANSLATED_TARGET_ARCH}  ?= "5.2" 
PREFERRED_VERSION_nativesdk-libgcc-initial                      ?= "5.2" 
PREFERRED_VERSION_nativesdk-libgcc                              ?= "5.2" 
PREFERRED_VERSION_gcc-cross-initial-${TARGET_ARCH}              ?= "5.2" 
PREFERRED_VERSION_gcc-source                                    ?= "5.2"
PREFERRED_VERSION_gcc-crosssdk-${SDK_ARCH}                      ?= "5.2"
PREFERRED_VERSION_gcc-sanitizers                                ?= "5.2"
PREFERRED_VERSION_nativesdk-gcc-sanitizers                      ?= "5.2"
```

## conf/machine/include/sun50i.inc
```bitbake
require conf/machine/include/arm/arch-armv8.inc

#TODO Check needed value
#DEFAULTTUNE ?=
```

## conf/machine/pine64.conf
```bitbake
#@TYPE: Machine
#@NAME: Pine 64 A64-Pine64 Board
#@DESCRIPTION: Machine configuration for the Pine 64 Board, based on Allwinner A64 CPU
#https://github.com/apritzel/pine64
#https://github.com/longsleep/linux-pine64

PREFERRED_PROVIDER_u-boot="u-boot-pine64"
PREFERRED_PROVIDER_virtual/bootloader="u-boot-pine64"
PREFERRED_PROVIDER_virtual/kernel ="linux-pine64"

KERNEL_IMAGETYPE="Image"
UBOOT_MACHINE = "sun50iw1p1_config"
UBOOT_ENTRYPOINT = "0x4a000000"
UBOOT_LOADADDRESS = "0x4a000000"

DEFAULTTUNE ?= "aarch64"

require conf/machine/include/sun50i.inc
include conf/machine/include/pine64-base.inc
```
